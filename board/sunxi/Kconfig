## board/sunxi/Kconfig
```kconfig
choice
	prompt "SPL Image Type"
	default SPL_IMAGE_TYPE_SUNXI_EGON

config SPL_IMAGE_TYPE_SUNXI_EGON
	bool "eGON (normal)"
	help
	  Select this option to embed the SPL binary in an eGON.BT0 image,
	  which is compatible with the normal boot ROM (NBROM).

	  This is usually the correct option to choose.

config SPL_IMAGE_TYPE_SUNXI_TOC0
	bool "TOC0 (secure)"
	help
	  Select this option to embed the SPL binary in a TOC0 image,
	  which is compatible with the secure boot ROM (SBROM).

endchoice

config SPL_IMAGE_TYPE
	string
	default "sunxi_egon" if SPL_IMAGE_TYPE_SUNXI_EGON
	default "sunxi_toc0" if SPL_IMAGE_TYPE_SUNXI_TOC0

config SUNXI_RUNTIME_BOARD_DETECTION
	bool "Runtime Board Detection"
	depends on (MACH_SUN50I || MACH_SUN50I_H616)
	help
	  Allow detection of a specific sub-type of boards during
	  runtime so that the correct device tree can be selected.

choice
	prompt "Runtime Board Selection"
	depends on SUNXI_RUNTIME_BOARD_DETECTION
	help
	  Choose the board specific runtime detection logic.

config PINE64_DT_SELECTION
	bool "Enable Pine64 device tree selection code"
	depends on (MACH_SUN50I && SUNXI_RUNTIME_BOARD_DETECTION)
	help
          The original Pine A64 and Pine A64+ are similar but different
	  boards and can be differed by the DRAM size. Pine A64 has
	  512MiB DRAM, and Pine A64+ has 1GiB or 2GiB. By selecting this
	  option, the device tree selection code specific to Pine64 which
	  utilizes the DRAM size will be enabled.

config PINEPHONE_DT_SELECTION
	bool "Enable PinePhone device tree selection code"
	depends on (MACH_SUN50I && SUNXI_RUNTIME_BOARD_DETECTION)
	help
	  Enable this option to automatically select the device tree for the
	  correct PinePhone hardware revision during boot.

config RG35XX_H700_DT_SELECTION
	bool "Enable RG35XX device tree selection code"
	depends on (MACH_SUN50I_H616 && SUNXI_RUNTIME_BOARD_DETECTION)
	help
	  Enable this option to automatically select the device tree for the
	  correct Anbernic RG35XX series device. This does not include any
	  of the RG35XX based devices built on the Actions Semi based SoC.

endchoice
```

## configs/anbernic_rg35xx_h700_defconfig
```kconfig
CONFIG_ARM=y
CONFIG_ARCH_SUNXI=y
CONFIG_DEFAULT_DEVICE_TREE="allwinner/sun50i-h700-anbernic-rg35xx-2024"
CONFIG_SPL=y
CONFIG_DRAM_SUN50I_H616_DX_ODT=0x08080808
CONFIG_DRAM_SUN50I_H616_DX_DRI=0x0e0e0e0e
CONFIG_DRAM_SUN50I_H616_CA_DRI=0x0e0e
CONFIG_DRAM_SUN50I_H616_ODT_EN=0x7887bbbb
CONFIG_DRAM_SUN50I_H616_TPR2=0x1
CONFIG_DRAM_SUN50I_H616_TPR6=0x40808080
CONFIG_DRAM_SUN50I_H616_TPR10=0x402f6633
CONFIG_DRAM_SUN50I_H616_TPR11=0x1a1e1e1b
CONFIG_MACH_SUN50I_H616=y
CONFIG_RESERVE_ALLWINNER_BOOT0_HEADER=y
CONFIG_SUNXI_DRAM_H616_LPDDR4=y
CONFIG_DRAM_CLK=672
CONFIG_R_I2C_ENABLE=y
CONFIG_SUNXI_RUNTIME_BOARD_DETECTION=y
CONFIG_DEFAULT_FDT_FILE="allwinner/sun50i-h700-anbernic-rg35xx-2024.dtb"
CONFIG_LAST_STAGE_INIT=y
CONFIG_SPL_I2C=y
CONFIG_CMD_BDINFO_EXTRA=y
CONFIG_CMD_BOOTDEV=y
CONFIG_CMD_BOOTMETH=y
CONFIG_CMD_BOOTZ=y
CONFIG_BOOTM_OPENRTOS=y
CONFIG_BOOTM_OSE=y
CONFIG_CMD_ADTIMG=y
CONFIG_CMD_ADC=y
CONFIG_CMD_CLK=y
# CONFIG_CMD_LOADB is not set
# CONFIG_CMD_LOADS is not set
CONFIG_CMD_BKOPS_ENABLE=y
CONFIG_CMD_MMC_REG=y
CONFIG_CMD_MMC_SWRITE=y
CONFIG_CMD_SDRAM=y
CONFIG_CMD_PMIC=y
CONFIG_CMD_REGULATOR=y
CONFIG_OF_UPSTREAM=y
CONFIG_OF_LIST="allwinner/sun50i-h700-anbernic-rg35xx-2024 allwinner/sun50i-h700-anbernic-rg35xx-h allwinner/sun50i-h700-anbernic-rg35xx-plus allwinner/sun50i-h700-anbernic-rg35xx-sp"
# CONFIG_NET is not set
CONFIG_BUTTON=y
CONFIG_BUTTON_GPIO=y
CONFIG_SPL_SYS_I2C_LEGACY=y
CONFIG_SYS_I2C_MVTWSI=y
CONFIG_SYS_I2C_SLAVE=0x7f
CONFIG_SYS_I2C_SPEED=400000
CONFIG_REGULATOR_AXP=y
CONFIG_AXP717_POWER=y
CONFIG_AXP_DCDC2_VOLT=940
CONFIG_AXP_DCDC3_VOLT=1100
CONFIG_REGEX=y
# CONFIG_EFI_LOADER is not set
```
